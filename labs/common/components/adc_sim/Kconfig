## labs/common/components/adc_sim/Kconfig
```kconfig
menu "ADC signal source (Lab 4)"

    config LAB_SIM_ADC
        bool "Use simulated ADC (adc_sim) instead of the real adc_oneshot driver"
        default y
        help
            When enabled (the default -- required for QEMU, which has no
            analog signal to sample), this component compiles a synthetic
            lab_adc_init()/lab_adc_read_raw() pair: a nominal 1.5 V input
            mapped through a fixed 12-bit ADC transfer function that
            deliberately carries a gain error (x1.03), an offset error
            (+25 LSB) and Gaussian noise (sigma ~= 8 LSB, from a seeded PRNG
            so the sequence is identical from one boot to the next) --
            see adc_sim/README.md for the exact ground-truth numbers.
            main/lab_adc_oneshot.c (the real driver, hardware only) is
            compiled OUT in this case.

            When disabled, this component's source file is empty (see its
            "#if CONFIG_LAB_SIM_ADC" guard) and main/lab_adc_oneshot.c's real
            adc_oneshot driver provides lab_adc_init()/lab_adc_read_raw()
            instead, sampling ADC1 channel 0 (GPIO0) for real.

            Same lab_adc.h API either way -- app_main() does not change.

endmenu
```

## labs/common/components/bme280_sim/Kconfig
```kconfig
menu "BME280 sensor source (Lab 3)"

    config LAB_SIM_BME280
        bool "Use simulated BME280 (bme280_sim) instead of the real I2C driver"
        default y
        help
            When enabled (the default -- required for QEMU, which has no I2C
            BME280 device), this component compiles a synthetic bme280_init()/
            bme280_read() pair: slow-sine temperature (20-25 degC), pressure
            close to 1013 hPa, humidity close to 45%. main/bme280_i2c.c (the
            real driver, hardware only) is compiled OUT in this case.

            When disabled, this component's source file is empty (see its
            "#if CONFIG_LAB_SIM_BME280" guard) and main/bme280_i2c.c's real
            i2c_master driver provides bme280_init()/bme280_read() instead,
            talking to an actual BME280 over I2C.

            Same bme280.h API either way -- app_main() does not change.

endmenu
```

## labs/lab4_adc_pwm/starter/main/Kconfig.projbuild
```kconfig
menu "Lab 4 two-point calibration constants"

    config LAB4_CAL_GAIN_PPM
        int "Calibration gain correction, in ppm (1000000 = x1.000)"
        default 970874
        help
            Multiplicative correction applied to a raw ADC code (after the
            offset correction below) to cancel out the ADC/sensor's known
            gain error, expressed in parts per million so it can be an
            integer Kconfig value: corrected = raw_after_offset * PPM/1e6.

            The default, 970874 (= round(1e6 / 1.03)), exactly cancels
            adc_sim's synthetic x1.03 gain error (see
            labs/common/components/adc_sim/README.md) -- on the real
            adc_oneshot path, re-derive this from two known reference
            voltages (two-point calibration) instead of trusting the
            default, which is sim-specific.

    config LAB4_CAL_OFFSET
        int "Calibration offset correction, in raw LSB"
        default 25
        help
            Subtracted from the raw ADC code before the gain correction
            above: corrected = (raw - OFFSET) * PPM/1e6.

            The default, 25, exactly cancels adc_sim's synthetic +25 LSB
            offset error (see labs/common/components/adc_sim/README.md) --
            on the real adc_oneshot path, re-derive this from two known
            reference voltages instead of trusting the default, which is
            sim-specific.

endmenu
```

## labs/lab5_rtos/starter/main/Kconfig.projbuild
```kconfig
choice LAB5_DEMO
    prompt "Lab 5 demo"
    default LAB5_DEMO_PIPELINE
    help
        Selects which of the three Lab 5 FreeRTOS demos this firmware image
        builds -- exactly one is ever compiled in (main/pipeline.c,
        main/race.c and main/inversion.c are each wrapped in
        "#if CONFIG_LAB5_DEMO_..." so only the selected file's app_main()
        exists). Switch demos with `idf.py menuconfig` (or by hand-editing
        sdkconfig) and rebuild. See the lab manual for what each one does
        and how to read its output.

    config LAB5_DEMO_PIPELINE
        bool "Sensor -> processing -> logger pipeline (queues, priorities, stack HWM)"
        help
            Three tasks glued by two queues: a 10 Hz sensor task feeds an
            8-sample moving-average processing task, which feeds a 1 Hz
            logger task. Prints "LAB5 OK avg=<t.t>" once a second and, at
            t~=30 s, each task's stack high-water mark ("LAB5 OK
            hwm_<task>=<bytes>"). This is the default, and the only demo
            exercised by qemu_smoke.sh.

    config LAB5_DEMO_RACE
        bool "Provoked race condition (unprotected counter, then mutex)"
        help
            Two equal-priority tasks each increment a shared counter 100000
            times, first with no lock at all (prints "LAB5 OK
            race_lost=<n>", n>0 -- the lost-update race), then again guarded
            by a mutex (prints "LAB5 OK race_lost=0").

    config LAB5_DEMO_INVERSION
        bool "Measured priority inversion (binary semaphore vs. mutex)"
        help
            A low-priority task takes a lock and busy-holds it; a
            medium-priority task (unrelated to the lock) hogs the CPU; a
            high-priority task blocks trying to take the same lock. Its
            blocking time is measured with esp_timer_get_time(), once with
            a plain binary semaphore ("LAB5 OK inv_sem_us=<n>") and once
            with a mutex, whose priority inheritance bounds the inversion
            ("LAB5 OK inv_mux_us=<m>"). Expect n >> m.

endchoice
```

## labs/lab6_mqtt/starter/main/Kconfig.projbuild
```kconfig
menu "Lab 6 (MQTT/TLS)"

    config LAB6_PLAINTEXT
        bool "Use plain MQTT (no TLS) instead of MQTT over TLS"
        default n
        help
            Default (n): connect with MQTT over TLS to mqtts://<LAB6_BROKER_HOST>:8883 and
            verify the broker against the CA cert embedded from
            main/certs/ca.crt (run broker/run_broker.sh first). This is the real
            lab target.

            When set (y): connect with plain MQTT to mqtt://<LAB6_BROKER_HOST>:1883 with no
            certificate. Provided for the automated QEMU smoke test only; the
            graded lab is the TLS path.

    config LAB6_BROKER_HOST
        string "Broker IP address, as the device sees it"
        default "10.0.2.2"
        help
            The app connects to mqtts://<this address>:8883 (or
            mqtt://<this address>:1883 with LAB6_PLAINTEXT). The default
            10.0.2.2 is this computer as seen from QEMU's user-mode
            network. On a board over Wi-Fi, set this computer's LAN IP
            address instead, and regenerate the certificates with it
            (bash ../broker/gen_certs.sh <LAN IP>): the broker certificate
            must list exactly this address in its subjectAltName.

endmenu
```
