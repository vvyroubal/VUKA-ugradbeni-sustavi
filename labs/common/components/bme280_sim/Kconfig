## labs/common/components/bme280_sim/Kconfig
```kconfig
menu "BME280 synthetic source (Labs 5 and 6)"

    config LAB_SIM_BME280
        bool "Synthetic BME280 values (bme280_sim) instead of a sensor"
        default y
        help
            Labs 5 and 6: bme280_init()/bme280_read() return synthetic
            values (slow-sine temperature 20-25 degC, pressure close to
            1013 hPa, humidity close to 45%) instead of reading a sensor.

            Lab 3 turns this off: there the students write the driver
            (main/bme280_i2c.c), which in QEMU reads the simulated
            registers of component bme280_regsim (CONFIG_LAB3_REG_SIM).

endmenu
```

## labs/lab3_bme280/starter/main/Kconfig.projbuild
```kconfig
menu "Lab 3 (BME280)"

config LAB3_REG_SIM
    bool "Simulated BME280 registers (QEMU) instead of the I2C bus"
    default y
    help
        On (the default): main/bme280_i2c.c reads and writes the
        simulated register map of component bme280_regsim instead
        of the I2C bus, so the whole driver -- chip-id probe,
        calibration unpacking, compensation -- runs in QEMU, with
        fixed registers and known expected results.
        Off (sdkconfig.hw, build directory build-hw): the real
        sensor on the I2C bus, on the board.

endmenu
```
