/*
 * adc_sim.c -- synthetic lab_adc.h implementation (QEMU / CI path).
 *
 * Ugradbeni racunalni sustavi -- Lab 4: ADC histograms, two-point
 * calibration, PWM
 *
 * Entirely wrapped in "#if CONFIG_LAB_SIM_ADC" so that, when the sim is
 * disabled (real-hardware build), this translation unit contributes no
 * symbols at all -- see Kconfig and each lab4_adc_pwm project's
 * main/lab_adc_oneshot.c, which is wrapped the mirror-image way
 * ("#if !CONFIG_LAB_SIM_ADC"). Exactly one of the two ever defines
 * lab_adc_init()/lab_adc_read_raw() in a given firmware image; the linker
 * would fail with duplicate symbols if both (or neither) did.
 *
 * ---------------------------------------------------------------------
 * Ground-truth data model (deterministic -- a seeded PRNG, not a
 * time/entropy source, so the exact sample sequence repeats every boot):
 *
 *   Nominal input voltage:     1.500 V
 *   Assumed ADC full-scale:    2.500 V  (matches the real driver's
 *                              ADC_ATTEN_DB_12 choice for ~1.5 V signals --
 *                              see lab_adc_oneshot.c)
 *   ADC width:                 12 bit (codes 0..4095)
 *   Ideal (error-free) code:   round(1500/2500 * 4095) = 2457
 *
 *   Synthetic transfer function applied on top of the ideal code:
 *     gain error:    x1.03            (SIM_ADC_GAIN_ERR)
 *     offset error:  +25 LSB          (SIM_ADC_OFFSET_ERR_LSB)
 *     noise:         Gaussian, sigma = 8 LSB (SIM_ADC_NOISE_SIGMA_LSB),
 *                    generated by a Box-Muller transform fed by a seeded
 *                    xorshift32 PRNG (SIM_ADC_PRNG_SEED)
 *
 *   raw = round(2457 * 1.03 + 25 + noise), clamped to [0, 4095]
 *       = round(2555.71 + noise)
 *
 *   So across a large sample (e.g. this lab's 1000-sample histogram), the
 *   sample mean should land close to 2555.7 raw with sample sd close to 8
 *   raw -- this is exactly the (known, fixed) gain/offset error a
 *   two-point calibration is meant to remove: correcting with gain =
 *   1e6/1.03 = 970874 ppm and offset = 25 LSB recovers ~2457 raw, i.e.
 *   ~1.500 V, to within a few raw counts. See main.c's CONFIG_LAB4_CAL_*
 *   Kconfig defaults, which match these constants exactly.
 * --------------------------------------------------------------------- */
#include "sdkconfig.h"
#if CONFIG_LAB_SIM_ADC

#include <math.h>
#include <stdint.h>
#include <stdbool.h>
#include "lab_adc.h"

#define SIM_ADC_FULLSCALE_MV      2500.0
#define SIM_ADC_NOMINAL_MV        1500.0
#define SIM_ADC_MAX_RAW           4095
#define SIM_ADC_NOMINAL_RAW       2457.0   /* round(1500/2500 * 4095), exact */

#define SIM_ADC_GAIN_ERR             1.03
#define SIM_ADC_OFFSET_ERR_LSB      25.0
#define SIM_ADC_NOISE_SIGMA_LSB      8.0

/* Fixed (not time-derived) seed: every boot reproduces the identical
 * sample sequence, so logs/histograms are reproducible run to run. */
#define SIM_ADC_PRNG_SEED   0x2463D9A1u

static const double TWO_PI = 6.28318530717958647692;

static uint32_t s_rng_state;
static bool s_have_spare;
static double s_spare;

/* xorshift32 (Marsaglia) -- small, fast, fully deterministic given a seed. */
static uint32_t xorshift32(void)
{
    uint32_t x = s_rng_state;
    x ^= x << 13;
    x ^= x >> 17;
    x ^= x << 5;
    s_rng_state = x;
    return x;
}

/* Uniform double strictly inside (0, 1) -- the "+1 / +2" trick keeps the
 * result away from both 0.0 (log(0) is undefined) and 1.0. */
static double rng_uniform01(void)
{
    return ((double)xorshift32() + 1.0) / (4294967295.0 + 2.0);
}

/* Box-Muller transform: each pair of uniforms yields two independent
 * standard-normal deviates; cache the second one instead of discarding it. */
static double rng_gaussian(void)
{
    if (s_have_spare) {
        s_have_spare = false;
        return s_spare;
    }
    double u1 = rng_uniform01();
    double u2 = rng_uniform01();
    double r = sqrt(-2.0 * log(u1));
    double z0 = r * cos(TWO_PI * u2);
    double z1 = r * sin(TWO_PI * u2);
    s_spare = z1;
    s_have_spare = true;
    return z0;
}

esp_err_t lab_adc_init(void)
{
    s_rng_state = SIM_ADC_PRNG_SEED;
    s_have_spare = false;
    return ESP_OK;
}

esp_err_t lab_adc_read_raw(int *raw)
{
    if (!raw) {
        return ESP_ERR_INVALID_ARG;
    }

    double noise = SIM_ADC_NOISE_SIGMA_LSB * rng_gaussian();
    double value = SIM_ADC_NOMINAL_RAW * SIM_ADC_GAIN_ERR + SIM_ADC_OFFSET_ERR_LSB + noise;

    long code = lround(value);
    if (code < 0) {
        code = 0;
    } else if (code > SIM_ADC_MAX_RAW) {
        code = SIM_ADC_MAX_RAW;
    }
    *raw = (int)code;
    return ESP_OK;
}

#endif /* CONFIG_LAB_SIM_ADC */
